## boards/antmicro/stm32h7_renode_reference_board/board.yml
```yaml
board:
  name: stm32h7_renode_reference_board
  full_name: Antmicro STM32H7 Renode Reference Board
  vendor: antmicro
  socs:
    - name: stm32h753xx
```
