## west.yml
```yaml
manifest:
  remotes:
    - name: zephyrproject-rtos
      url-base: https://github.com/zephyrproject-rtos
  projects:
    - name: zephyr
      remote: zephyrproject-rtos
      revision: c605ea46e15fb9bdd518670258a8a52d8850d8f4
      import:
        name-allowlist:
          - cmsis_6
          - hal_stm32
          - hal_st
```
