## west.yml
```yaml
manifest:
  remotes:
    - name: zephyrproject-rtos
      url-base: https://github.com/zephyrproject-rtos
  projects:
    - name: zephyr
      remote: zephyrproject-rtos
      revision: ba5f45776701fa34fd1c1e53c5d6d786ae27e910
      import:
        name-allowlist:
          - cmsis_6
          - hal_stm32
          - hal_st
```
